## CMakeLists.txt
```
# Copyright (c) 2026 Cliff Brake
# SPDX-License-Identifier: Apache-2.0

cmake_minimum_required(VERSION 3.20.0)

# Build against the module this sample lives in, so no manifest entry is needed.
list(APPEND ZEPHYR_EXTRA_MODULES ${CMAKE_CURRENT_SOURCE_DIR}/../..)

find_package(Zephyr REQUIRED HINTS $ENV{ZEPHYR_BASE})
project(nats_request_sample)

target_sources(app PRIVATE src/main.c)
```

## sample.yaml
```
sample:
  description: Make a NATS request every few seconds
  name: nats_request
common:
  tags:
    - net
    - nats
  platform_allow:
    - native_sim
  integration_platforms:
    - native_sim
tests:
  sample.net.nats.request:
    build_only: true
  sample.net.nats.request.host:
    build_only: true
    extra_args:
      - EXTRA_CONF_FILE=overlay-host.conf
```

## prj.conf
```kconfig
CONFIG_NETWORKING=y
CONFIG_NET_IPV4=y
CONFIG_NET_TCP=y
CONFIG_NATS=y

CONFIG_LOG=y
CONFIG_TEST_RANDOM_GENERATOR=y

# Static IPv4 address for native_sim with the net-tools "zeth" interface,
# whose host side is 192.0.2.2.
CONFIG_NET_CONFIG_SETTINGS=y
CONFIG_NET_CONFIG_NEED_IPV4=y
CONFIG_NET_CONFIG_MY_IPV4_ADDR="192.0.2.1"
CONFIG_NET_CONFIG_MY_IPV4_GW="192.0.2.2"
CONFIG_NET_CONFIG_MY_IPV4_NETMASK="255.255.255.0"
```

## overlay-host.conf
```kconfig
# Run on the host's own network stack, for testing without root.
#
# native_sim normally reaches the network through the "zeth" TAP interface,
# which needs root to create. With offloaded sockets the socket calls go
# straight to the host, so the sample reaches a nats-server on localhost.

CONFIG_NET_DRIVERS=y
CONFIG_NET_SOCKETS_OFFLOAD=y
CONFIG_NET_NATIVE_OFFLOADED_SOCKETS=y
CONFIG_ETH_NATIVE_TAP=n

# The host stack provides the addressing.
CONFIG_NET_CONFIG_SETTINGS=n
CONFIG_NET_CONFIG_NEED_IPV4=n

CONFIG_SAMPLE_NATS_URL="nats://127.0.0.1:4222"
```

## src/main.c
```c
/*
 * Copyright (c) 2026 Cliff Brake
 * SPDX-License-Identifier: Apache-2.0
 *
 * Send a request on zephyr.sample.echo every two seconds and log the reply.
 * Any NATS responder can answer, for example:
 *
 *   nats reply zephyr.sample.echo 'hello from the server'
 */

#include <zephyr/kernel.h>
#include <zephyr/logging/log.h>
#include <zephyr/net/nats.h>

LOG_MODULE_REGISTER(nats_request, LOG_LEVEL_INF);

static struct nats_client client;

int main(void)
{
	const struct nats_config cfg = {
		.url = CONFIG_SAMPLE_NATS_URL,
		.name = "zephyr-request",
	};
	char reply[64];
	size_t len;
	int ret;

	ret = nats_client_init(&client, &cfg);
	if (ret < 0) {
		LOG_ERR("invalid config (%d)", ret);
		return 0;
	}

	LOG_INF("connecting to %s", CONFIG_SAMPLE_NATS_URL);
	nats_connect(&client, K_SECONDS(10));

	for (;;) {
		ret = nats_request(&client, "zephyr.sample.echo", "ping", 4, reply, sizeof(reply),
				   &len, K_SECONDS(1));
		switch (ret) {
		case 0:
			LOG_INF("reply: %s", reply);
			break;
		case -EHOSTUNREACH:
			LOG_INF("no responders");
			break;
		case -ETIMEDOUT:
			LOG_INF("timed out");
			break;
		case -ENOBUFS:
			LOG_INF("reply truncated from %zu bytes: %s", len, reply);
			break;
		default:
			LOG_INF("request failed (%d)", ret);
			break;
		}
		k_sleep(K_SECONDS(2));
	}

	return 0;
}
```
